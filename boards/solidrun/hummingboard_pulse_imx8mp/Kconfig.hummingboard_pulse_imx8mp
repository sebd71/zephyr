## boards/solidrun/hummingboard_pulse_imx8mp/Kconfig.hummingboard_pulse_imx8mp
```kconfig
config BOARD_HUMMINGBOARD_PULSE_IMX8MP
	select SOC_MIMX8ML8_M7 if BOARD_HUMMINGBOARD_PULSE_IMX8MP_MIMX8ML8_M7 || BOARD_HUMMINGBOARD_PULSE_IMX8MP_MIMX8ML8_M7_DDR
	select SOC_PART_NUMBER_MIMX8ML8DVNLZ
```

## boards/solidrun/hummingboard_pulse_imx8mp/board.yml
```yaml
board:
  name: hummingboard_pulse_imx8mp
  vendor: solidrun
  socs:
  - name: mimx8ml8
    variants:
    - name: ddr
      cpucluster: m7
```
